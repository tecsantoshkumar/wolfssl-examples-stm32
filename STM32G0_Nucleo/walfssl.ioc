# file: walfssl.ioc
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Mcu.Family=STM32G0
Mcu.Name=STM32G0B1C(B-C-E)Tx
Mcu.Package=LQFP48
PA13.Mode=Serial_Wire
PA13.Signal=SYS_SWDIO
PA14-BOOT0.Mode=Serial_Wire
PA14-BOOT0.Signal=SYS_SWCLK
ProjectManager.HeapSize=0x200
ProjectManager.StackSize=0x400
ProjectManager.TargetToolchain=STM32CubeIDE
RCC.AHBFreq_Value=16000000
RCC.CortexFreq_Value=16000000
RCC.EXTERNAL_CLOCK_VALUE=48000
RCC.FDCANCLockSelection=RCC_FDCANCLKSOURCE_PLL
RCC.HCLKFreq_Value=16000000
RCC.HSE_VALUE=8000000
RCC.HSI48_VALUE=48000000
RCC.HSI_VALUE=16000000
RCC.LSE_VALUE=32768
RCC.SYSCLKFreq_VALUE=16000000
RCC.USBFreq_Value=48000000
RCC.VCOOutputFreq_Value=128000000
VP_IWDG_VS_IWDG.Mode=IWDG_Activate
VP_SYS_VS_DBSignals.Mode=DisableDeadBatterySignals
VP_wolfSSL.I-CUBE-wolfSSL_VS_wolfSSLJjwolfSSL_5.5.4_5.5.4.Mode=wolfSSLJjwolfSSL
board=custom
wolfSSL.I-CUBE-wolfSSL.5.5.4.WOLF_CONF_AESCBC=1
wolfSSL.I-CUBE-wolfSSL.5.5.4.WOLF_CONF_AESGCM=0
wolfSSL.I-CUBE-wolfSSL.5.5.4.WOLF_CONF_BASE64_ENCODE=1
wolfSSL.I-CUBE-wolfSSL.5.5.4.WOLF_CONF_DEBUG=1
wolfSSL.I-CUBE-wolfSSL.5.5.4.WOLF_CONF_DH=0
wolfSSL.I-CUBE-wolfSSL.5.5.4.WOLF_CONF_ECC=0
wolfSSL.I-CUBE-wolfSSL.5.5.4.WOLF_CONF_KEEP_PEER_CERT=1
wolfSSL.I-CUBE-wolfSSL.5.5.4.WOLF_CONF_MD5=1
wolfSSL.I-CUBE-wolfSSL.5.5.4.WOLF_CONF_OPENSSL_EXTRA=2
wolfSSL.I-CUBE-wolfSSL.5.5.4.WOLF_CONF_PSK=1
wolfSSL.I-CUBE-wolfSSL.5.5.4.WOLF_CONF_PWDBASED=1
wolfSSL.I-CUBE-wolfSSL.5.5.4.WOLF_CONF_RNG=0
wolfSSL.I-CUBE-wolfSSL.5.5.4.WOLF_CONF_RSA=0
wolfSSL.I-CUBE-wolfSSL.5.5.4.WOLF_CONF_WOLFCRYPT_ONLY=1
wolfSSL.I-CUBE-wolfSSL.5.5.4.wolfSSLCcwolfSSLJjwolfCryptJjCore=true
wolfSSL.I-CUBE-wolfSSL.5.5.4.wolfSSLCcwolfSSLJjwolfCryptJjTest=true
wolfSSL.I-CUBE-wolfSSL.5.5.4.wolfSSLCcwolfSSLJjwolfSSLJjCore=true

// file: Core/Src/main.c
/* USER CODE BEGIN Header */
/**
  ******************************************************************************
  * @file           : main.c
  * @brief          : Main program body
  ******************************************************************************
  * @attention
  *
  * Copyright (c) 2024 STMicroelectronics.
  * All rights reserved.
  *
  * This software is licensed under terms that can be found in the LICENSE file
  * in the root directory of this software component.
  * If no LICENSE file comes with this software, it is provided AS-IS.
  *
  ******************************************************************************
  */
/* USER CODE END Header */
#include "main.h"

/* USER CODE BEGIN Includes */
#include <stdio.h>
#include <string.h>

#ifndef WOLFSSL_USER_SETTINGS
    #include <wolfssl/options.h>
#endif

#include <wolfssl/wolfcrypt/pwdbased.h>  // For wc_PBKDF2_HMAC
#include <wolfssl/wolfcrypt/aes.h>       // For wc_AesSetKeyDirect
#include <user_settings.h>
#include <wolfssl/options.h>
#include <wolfssl/wolfcrypt/settings.h>
#include <wolfssl/wolfcrypt/error-crypt.h>
#include <wolfssl/wolfcrypt/pkcs7.h>
#include <wolfssl/wolfcrypt/sha256.h>

/* USER CODE END Includes */

void SystemClock_Config(void);
static void MX_GPIO_Init(void);
static void MX_IWDG_Init(void);

/* USER CODE BEGIN 0 */
#define AES_BLOCK_SIZE 16
#define KEY_SIZE 32

void encrypt_string(const char* password, int pLen, const char* salt, int sLen, int iteration_count, const char* plaintext, int ptLen)
{
   byte key[KEY_SIZE];             // 256-bit key
   byte iv[AES_BLOCK_SIZE] = {0}; // Initialization Vector
   byte ciphertext[1024];          // Adjust size as needed
   int ciphertext_len;

   // Derive key from password and salt using PBKDF2-HMAC-SHA1
   if (wc_PBKDF2(key, (const byte*)password, pLen, (const byte*)salt, sLen, iteration_count, KEY_SIZE, WC_HASH_TYPE_SHA256) != 0) {
       printf("Error deriving key\n");
       return;
   }

   Aes aes;
   if (wc_AesSetKey(&aes, key, KEY_SIZE, iv, AES_ENCRYPTION) != 0) {
       printf("Error setting AES key\n");
       return;
   }

   // Perform encryption
   if (wc_AesCbcEncrypt(&aes, ciphertext, (const byte*)plaintext, ptLen) != 0) {
       printf("Error encrypting data\n");
       return;
   }

   // Clear the key from memory
   memset(key, 0, sizeof(key));

   // Print encrypted data as hex
   printf("Encrypted (hex): ");
   for (int i = 0; i < ptLen; i++) {
       printf("%02x", ciphertext[i]);
   }
   printf("\n");

   wc_AesFree(&aes);
}
/* USER CODE END 0 */

int main(void)
{
  /* USER CODE BEGIN 1 */

  //  int ciphertext_len;

  /* USER CODE END 1 */

  /* MCU Configuration--------------------------------------------------------*/

  /* Reset of all peripherals, Initializes the Flash interface and the Systick. */
  HAL_Init();

  /* Configure the system clock */
  SystemClock_Config();

  /* Initialize all configured peripherals */
  MX_GPIO_Init();
  MX_IWDG_Init();
  /* USER CODE BEGIN 2 */

   wolfCrypt_Init();

     char* password = "tecsantoshkumar_secret_key";
     char* salt = "tecsantoshkumarsalt_1";
    char* plaintext = "tecsantoshkumar";
    int iteration_count = 65536;

    byte key[KEY_SIZE];             // 256-bit key
    byte iv[AES_BLOCK_SIZE] = {0}; // Initialization Vector
    byte ciphertext[1024];          // Adjust size as needed

   int rst = wc_PBKDF2(key, (byte*)password, strlen(password), (byte*)salt, strlen(salt), iteration_count, KEY_SIZE, WC_HASH_TYPE_SHA256);

   if (rst != 0)
   {
        printf("Error deriving key\n");
   }
    encrypt_string(password, strlen(password), salt, strlen(salt), iteration_count, plaintext, strlen(plaintext));
  /* USER CODE END 2 */

  /* Infinite loop */
  while (1)
  {

  }
}

void SystemClock_Config(void)
{
  RCC_OscInitTypeDef RCC_OscInitStruct = {0};
  RCC_ClkInitTypeDef RCC_ClkInitStruct = {0};

  /** Configure the main internal regulator output voltage
  */
  HAL_PWREx_ControlVoltageScaling(PWR_REGULATOR_VOLTAGE_SCALE1);
  /** Initializes the RCC Oscillators according to the specified parameters
  * in the RCC_OscInitTypeDef structure.
  */
  RCC_OscInitStruct.OscillatorType = RCC_OSCILLATORTYPE_HSI|RCC_OSCILLATORTYPE_LSI;
  RCC_OscInitStruct.HSIState = RCC_HSI_ON;
  RCC_OscInitStruct.HSIDiv = RCC_HSI_DIV1;
  RCC_OscInitStruct.HSICalibrationValue = RCC_HSICALIBRATION_DEFAULT;
  RCC_OscInitStruct.LSIState = RCC_LSI_ON;
  RCC_OscInitStruct.PLL.PLLState = RCC_PLL_NONE;
  if (HAL_RCC_OscConfig(&RCC_OscInitStruct) != HAL_OK)
  {
    Error_Handler();
  }
  /** Initializes the CPU, AHB and APB buses clocks
  */
  RCC_ClkInitStruct.ClockType = RCC_CLOCKTYPE_HCLK|RCC_CLOCKTYPE_SYSCLK
                              |RCC_CLOCKTYPE_PCLK1;
  RCC_ClkInitStruct.SYSCLKSource = RCC_SYSCLKSOURCE_HSI;
  RCC_ClkInitStruct.AHBCLKDivider = RCC_SYSCLK_DIV1;
  RCC_ClkInitStruct.APB1CLKDivider = RCC_HCLK_DIV1;

  if (HAL_RCC_ClockConfig(&RCC_ClkInitStruct, FLASH_LATENCY_0) != HAL_OK)
  {
    Error_Handler();
  }
}

static void MX_IWDG_Init(void)
{

  LL_IWDG_Enable(IWDG);
  LL_IWDG_EnableWriteAccess(IWDG);
  LL_IWDG_SetPrescaler(IWDG, LL_IWDG_PRESCALER_4);
  LL_IWDG_SetReloadCounter(IWDG, 4095);
  while (LL_IWDG_IsReady(IWDG) != 1)
  {
  }

  LL_IWDG_ReloadCounter(IWDG);

}

static void MX_GPIO_Init(void)
{

  /* GPIO Ports Clock Enable */
  __HAL_RCC_GPIOA_CLK_ENABLE();

}

void Error_Handler(void)
{
  __disable_irq();
  while (1)
  {
  }
}
